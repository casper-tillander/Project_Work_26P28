## prj.conf
```kconfig
CONFIG_CONSOLE=y
CONFIG_PRINTK=y
CONFIG_SERIAL=y
CONFIG_UART_CONSOLE=y
CONFIG_MAIN_STACK_SIZE=4096
CONFIG_FPU=y
```

## src/rf_regressor_model.h
```c
#ifndef RF_REGRESSOR_MODEL_H
#define RF_REGRESSOR_MODEL_H

#define RF_REG_TREE_COUNT 10
#define RF_REG_FEATURE_COUNT 26
#define RF_REG_OUTPUT_COUNT 6
#define RF_REG_TOTAL_NODE_COUNT 504

extern const int rf_reg_tree_offsets[RF_REG_TREE_COUNT];
extern const int rf_reg_tree_node_counts[RF_REG_TREE_COUNT];

extern const int rf_reg_features[RF_REG_TOTAL_NODE_COUNT];
extern const float rf_reg_thresholds[RF_REG_TOTAL_NODE_COUNT];
extern const int rf_reg_children_left[RF_REG_TOTAL_NODE_COUNT];
extern const int rf_reg_children_right[RF_REG_TOTAL_NODE_COUNT];
extern const float rf_reg_leaf_values[RF_REG_TOTAL_NODE_COUNT][RF_REG_OUTPUT_COUNT];

void rf_regressor_predict(
    const float features[RF_REG_FEATURE_COUNT],
    float outputs[RF_REG_OUTPUT_COUNT]
);

#endif
```
